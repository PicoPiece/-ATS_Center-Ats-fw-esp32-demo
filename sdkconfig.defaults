## sdkconfig.defaults
```kconfig
# WiFi + SmartConfig + SNTP
CONFIG_ESP_WIFI_ENABLED=y
CONFIG_ESP_WIFI_SOFTAP_SUPPORT=y
CONFIG_LWIP_SNTP_MAX_SERVERS=3

# Partition table: single factory app (no OTA), 1.5 MB app
CONFIG_PARTITION_TABLE_SINGLE_APP_LARGE=y

# Stack sizes (SmartConfig + WiFi + NTP need more stack)
CONFIG_ESP_MAIN_TASK_STACK_SIZE=4096
```
